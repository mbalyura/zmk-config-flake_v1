## boards/shields/anywhy_flake/Kconfig.defconfig
```kconfig
if SHIELD_ANYWHY_FLAKE_LEFT

config ZMK_KEYBOARD_NAME
    default "Anywhy Flake"

config ZMK_SPLIT_BLE_ROLE_CENTRAL
    default y

config ZMK_USB
	default y

config ZMK_STUDIO
    default y

endif

if SHIELD_ANYWHY_FLAKE_LEFT || SHIELD_ANYWHY_FLAKE_RIGHT

config ZMK_SPLIT
    default y

config ZMK_BLE
	default y

endif
```
